/* Permission is hereby granted, free of charge, to any person obtaining a copy
 * of this software and associated documnetation files (the "Software"), to deal
 * in the Software without restriction, including without limitation the rights
 * to use, copy, modify, merge, publish, distribute, sublicense, and/or sell
 * copies of the Software, and to permit persons to  whom the Software is
 * furished to do so, subject to the following conditions:
 *
 * The above copyright notice and this permission notice shall be included in
 * all copies or substantial portions of the Software.
 *
 * THE SOFTWARE IS PROVIDED "AS IS", WITHOUT WARRANTY OF ANY KIND, EXPRESS OR
 * IMPLIED, INCLUDING BUT NOT LIMITED TO THE WARRANTIES OF MERCHANTABILITY,
 * FITNESS OR A PARTICULAR PURPOSE AND NONINFRINGEMENT. IN NO EVENT SHALL THE
 * AUTHORS OR COPYRIGHT HOLDERS BE LIABLE FOR ANY CLAIM, DAMAGES OR OTHER
 * LIABILITY WHETHER IN AN ACTION OF CONTRACT, TORT OR OTHERWISE, ARISING FROM,
 * OUT OF OR IN CONNECTION WITH THE SOFTWARE OR THE USE OR OTHER DEALINGS IN
 * THE SOFTWARE.
 */

#include <avr/interrupt.h>
#include <avr/io.h>
#include <avr/pgmspace.h>

#define F_CPU 15271212
#define USART_BAUDRATE 31250 
#define BAUD_PRESCALE (((F_CPU / (USART_BAUDRATE * 16UL))) - 1)

const unsigned char PS_2 = (1 << ADPS0);;
const unsigned char PS_4 = (1 << ADPS1);
const unsigned char PS_8 = (1 << ADPS1) | (1 << ADPS0);
const unsigned char PS_16 = (1 << ADPS2);
const unsigned char PS_32 = (1 << ADPS2) | (1 << ADPS0);
const unsigned char PS_64 = (1 << ADPS2) | (1 << ADPS1);
const unsigned char PS_128 = (1 << ADPS2) | (1 << ADPS1) | (1 << ADPS0);

#ifndef cbi
#define cbi(sfr, bit) (_SFR_BYTE(sfr) &= ~_BV(bit))
#endif
#ifndef sbi
#define sbi(sfr, bit) (_SFR_BYTE(sfr) |= _BV(bit))
#endif 

// Standard Arduino Pins
#define digitalPinToPortReg(P) \
(((P) >= 0 && (P) <= 7) ? &PORTD : (((P) >= 8 && (P) <= 13) ? &PORTB : &PORTC))
#define digitalPinToDDRReg(P) \
(((P) >= 0 && (P) <= 7) ? &DDRD : (((P) >= 8 && (P) <= 13) ? &DDRB : &DDRC))
#define digitalPinToPINReg(P) \
(((P) >= 0 && (P) <= 7) ? &PIND : (((P) >= 8 && (P) <= 13) ? &PINB : &PINC))
#define digitalPinToBit(P) \
(((P) >= 0 && (P) <= 7) ? (P) : (((P) >= 8 && (P) <= 13) ? (P) - 8 : (P) - 14))

#define digitalReadFast(P) bitRead(*digitalPinToPINReg(P), digitalPinToBit(P))
                  
#define digitalWriteFast(P, V) bitWrite(*digitalPinToPortReg(P), digitalPinToBit(P), (V))


#define TOGD2 PORTD ^= 4

const uint8_t BD[] PROGMEM = 
{
127,124,115,109,116,110,103,104,97,96,92,89,91,88,89,85,81,78,71,64,65,67,68,64,62,65,66,64,65,62,62,62,64,64,66,66,68,69,70,71,72,72,74,78,
  83,79,84,87,72,95,122,136,70,75,96,110,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106,
  103,87,85,93,81,77,83,93,88,73,69,65,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107,
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  128,128,128,128,128,128,128,128,128,128,128,128,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128
};

const uint8_t SN[] PROGMEM =
{
130,143,152,140,112,95,101,101,97,106,136,152,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101,
  117,106,102,119,140,130,127,150,118,125,178,135,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121,
  106,109,125,96,99,135,146,137,134,142,155,133,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139,
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  127,128,128,128,128,128,128,128,128,128,128,128,128,129,129,129,129,128,128,128,128,128,128,128,129,129,128,127,127,128,129,129,128
};

const uint8_t HH[] PROGMEM =
{
128,131,142,131,123,144,109,153,108,135,139,101,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130,
  153,97,183,43,183,127,77,233,61,116,212,27,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142,
  103,148,133,60,153,84,153,105,105,146,150,90,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165,
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  127,128,129,128,126,129,128
};

const uint8_t TO[] PROGMEM =
{
132,125,137,125,129,122,127,131,125,131,123,145,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122,
  139,116,137,133,133,132,131,130,127,130,127,121,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120,
  165,183,135,139,127,144,149,154,134,116,129,148,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96,
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  127,128,128,128,128,128,128,127,128,128,128,128,127,127,127,128
};

const uint8_t CY[] PROGMEM =
{
129,108,128,146,106,135,147,102,132,158,104,130,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183,
  98,118,176,81,118,177,95,130,161,85,132,153,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145,
  133,140,138,111,112,104,146,125,150,140,80,154,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84,
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  129,129,129,129,129,129,129,129,129,129,129,129,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128  
};

const uint8_t CL[] PROGMEM =
{
 125,122,122,128,130,125,120,130,141,134,111,110,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17,
 42,165,215,201,89,38,103,223,211,144,52,60,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11,
  1,41,110,255,102,107,255,61,39,1,19,43,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191,
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  129,129,129,129,129,128 
};


 volatile uint8_t MIDISTATE=0;
 volatile uint8_t MIDIRUNNINGSTATUS=0;
 volatile uint8_t MIDINOTE;
 volatile uint8_t MIDIVEL;
 volatile uint8_t MIDItriggers[8]={0xFF,0xFF,0xFF,0xFF,0xFF,0xFF,0xFF,0xFF};



ISR(USART_RX_vect) {
 uint8_t MIDIRX;

MIDIRX = UDR0;

/*
 Handling â€œRunning statusâ€
1.Buffer is cleared (ie, set to 0) at power up.
 2.Buffer stores the status when a Voice Category Status (ie, 0x80 to 0xEF) is received.
 3.Buffer is cleared when a System Common Category Status (ie, 0xF0 to 0xF7) is received.
 4.Nothing is done to the buffer when a RealTime Category message is received.
 5.Any data bytes are ignored when the buffer is 0.
 */

if ((MIDIRX>0xBF)&&(MIDIRX<0xF8)) {
 MIDIRUNNINGSTATUS=0;
 MIDISTATE=0;
 return;
 }

if (MIDIRX>0xF7) return;

if (MIDIRX & 0x80) {
 MIDIRUNNINGSTATUS=MIDIRX;
 MIDISTATE=1;
 return;
 }

if (MIDIRX < 0x80) {
 if (!MIDIRUNNINGSTATUS) return;
 if (MIDISTATE==1) {
 MIDINOTE=MIDIRX;
 MIDISTATE++;
 return;
 }
 if (MIDISTATE==2) {
 MIDIVEL=MIDIRX;
 MIDISTATE=1;
 //if ((MIDIRUNNINGSTATUS==0x8A)||(MIDIRUNNINGSTATUS==0x9A)) handleMIDINOTE(MIDIRUNNINGSTATUS,MIDINOTE,MIDIVEL);
 //if (MIDIRUNNINGSTATUS==0xBA) handleMIDICC(MIDINOTE,MIDIVEL);

return;
 }
 }

return;
 }

void setup() {
  OSCCAL=0xFF;
  
  //6 TRIG inputs
    //PB4 - BD
    //PB5 - SD
    //PB0 - HH
    //PD7 - HT
    //PB7 - CL
    //PB6 - RD
    DDRB=0x06;
    PORTB=0xf1;
    DDRD=0x7f;
    PORTD=0x80;
    
    pinMode(1,OUTPUT);
    
    //6 DAC outputs   
    pinMode(5,OUTPUT);
    pinMode(6,OUTPUT);
    pinMode(9,OUTPUT);
    pinMode(10,OUTPUT);
    pinMode(3,OUTPUT);
    pinMode(11,OUTPUT);

    
    

    cli();
    
    TCCR0A = ((1<<COM0B1)|(1<<COM0A1)|(1<<WGM01)|(1<<WGM00));    
    TCCR0B = ((0<<CS01)|(1<<CS00));

    TCCR1A = (1<<WGM10)|(1<<COM1A1)   // Set up the two Control registers of Timer1. 
             |(1<<COM1B1);             // Wave Form Generation is Fast PWM 8 Bit, 
    TCCR1B = (1<<WGM12)|(1<<CS12)     // OC1A and OC1B are cleared on compare match 
             |(1<<CS10);               // and set at BOTTOM. Clock Prescaler is 1024.
    TCCR1B = (TCCR1B & ~(_BV(CS12) | _BV(CS11))) | _BV(CS10); //No prescaler

    TCCR2A = _BV(COM2A1) | _BV(COM2B1) | _BV(WGM21) | _BV(WGM20);
    TCCR2B = _BV(CS20);
    
    TIMSK0 = 0;
    TIMSK1 = 0;
    TIMSK2 = 0;

    OCR0A = 127;
    OCR0B = 127;
    OCR1A = 127;
    OCR1B = 127;
    OCR2A = 127;
    OCR2B = 127;
    
    sei();

   
    // Set baud rate to 31,250. Requires modification if clock speed is not 16MHz.
   UCSR0B = (1 << RXEN0);   // Turn on reception circuitry 
   UCSR0C = (1 << UCSZ00) | (1 << UCSZ01); // Use 8-bit character sizes 

   UBRR0H = (BAUD_PRESCALE >> 8); // Load upper 8-bits of the baud rate value into the high byte of the UBRR register 
   UBRR0L = BAUD_PRESCALE; // Load lower 8-bits of the baud rate value into the low byte of the UBRR register

    // USART RX interrupt enable bit on
    UCSR0B |= _BV(RXCIE0);

    // set up the ADC
    uint16_t SFREQ=analogRead(0);
    ADCSRA &= ~PS_128;  // remove bits set by Arduino library
    // Choose prescaler PS_128.
    ADCSRA |= PS_32;
    ADMUX = 64;
    sbi(ADCSRA, ADSC);

}

void loop() {
  uint8_t phaccBD,phaccSD,phaccCH,phaccOH,phaccLT,phaccHT,phaccCY;
  uint8_t pitchBD=128;
  uint8_t pitchSD=128;
  uint8_t pitchCH=128;
  uint8_t pitchOH=128;
  uint8_t pitchLT=128;
  uint8_t pitchCY=128;

  uint16_t samplecntBD,samplecntSD,samplecntCH,samplecntOH,samplecntLT,samplecntCY;
  uint16_t samplepntBD,samplepntSD,samplepntCH,samplepntOH,samplepntLT,samplepntCY;
  
  uint8_t dread1,dread2,dread3,dread4,dread5,dread6;
  uint8_t odread1,odread2,odread3,odread4,odread5,odread6;

  
  int16_t total;
  uint8_t oldPORTB;
  uint8_t oldPORTD;

  uint8_t divider;
  uint8_t MUX=0;
  
  while(1) { 
    //midi.update();
    if (!(ADCSRA & 64)) {
      uint16_t pitch=((ADCL+(ADCH<<8))>>3)+1;

      if (MUX==0) pitchBD=pitch;
      if (MUX==1) pitchSD=pitch;
      if (MUX==2) pitchCH=pitch;
      if (MUX==3) pitchLT=pitch;
      if (MUX==4) pitchOH=pitch;
      if (MUX==5) pitchCY=pitch;

      MUX++;
      if (MUX==6) MUX=0;
      ADMUX = 64 | MUX; //Select MUX
      sbi(ADCSRA, ADSC); //start next conversation
          
     if (samplecntBD) {
            phaccBD+=pitchBD;
            if (phaccBD & 128) {
                phaccBD &= 127;
                OCR1A=pgm_read_byte_near(BD + samplepntBD);
                samplepntBD++;
                samplecntBD--;
                
            }
      }
      if (samplecntSD) {
            phaccSD+=pitchSD;
            if (phaccSD & 128) {
                phaccSD &= 127;
                OCR1B=pgm_read_byte_near(SN + samplepntSD);
                samplepntSD++;
                samplecntSD--;
                
            }
      }
      if (samplecntCH) {
            phaccCH+=pitchCH;
            if (phaccCH & 128) {
                phaccCH &= 127;
                OCR2A=pgm_read_byte_near(HH + samplepntCH);
                samplepntCH++;
                samplecntCH--;
                
            }
      }
      if (samplecntLT) {
            phaccLT+=pitchLT;
            if (phaccLT & 128) {
                phaccLT &= 127;
                OCR0A=pgm_read_byte_near(TO + samplepntLT);
                samplepntLT++;
                samplecntLT--;
                
            }
      }
      if (samplecntOH) {
            phaccOH+=pitchOH;
            if (phaccOH & 128) {
                phaccOH &= 127;
                OCR0B=pgm_read_byte_near(CL + samplepntOH);
                samplepntOH++;
                samplecntOH--;
                
            }
      }     
      if (samplecntCY) {
            phaccCY+=pitchCY;
            if (phaccCY & 128) {
                phaccCY &= 127;
                 OCR2B=pgm_read_byte_near(CY + samplepntCY);
                samplepntCY++;
                samplecntCY--;
                
            }
      }  

    }


//----------------- Handle Triggers ------------------------------
        //PB4 - BD
        //PB5 - SD
        //PB0 - HH
        //PD7 - HT
        //PB7 - CL
        //PB6 - RD

        dread1=PINB&16;
        dread2=PINB&32;
        dread3=PINB&1;
        dread4=PIND&128;
        dread5=PINB&128;
        dread6=PINB&64;
        
        if (dread1!=odread1) {
        odread1=dread1;
        if (odread1) {
          samplepntBD=0;
          samplecntBD=sizeof(BD);
        }
      }
      if (dread2!=odread2) {
        odread2=dread2;
        if (odread2) {
          samplepntSD=0;
          samplecntSD=sizeof(SN);
        }
      }
      if (dread3!=odread3) {
        odread3=dread3;
        if (odread3) {
          samplepntCH=0;
          samplecntCH=sizeof(HH);
        }
      }
      if (dread4!=odread4) {
        odread4=dread4;
        if (odread4) {
          samplepntLT=0;
          samplecntLT=sizeof(TO);
        }
      }
      if (dread5!=odread5) {
        odread5=dread5;
        if (odread5) {
          samplepntOH=0;
          samplecntOH=sizeof(CL);
        }
      }
      if (dread6!=odread6) {
        odread6=dread6;
        if (odread6) {
          samplepntCY=0;
          samplecntCY=sizeof(CY);
        }
      }


//-----------------------------------------------------------------



      
    }

}



